# file: Weather_station.ioc
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Mcu.Family=STM32F1
Mcu.Name=STM32F103C(8-B)Tx
Mcu.Package=LQFP48
NVIC.PriorityGroup=NVIC_PRIORITYGROUP_4
NVIC.TIM1_UP_IRQn=true\:15\:0\:false\:false\:true\:false\:true\:true
NVIC.TimeBase=TIM1_UP_IRQn
NVIC.TimeBaseIP=TIM1
PA13.Mode=JTAG_4_pins
PA13.Signal=SYS_JTMS-SWDIO
PA14.Mode=JTAG_4_pins
PA14.Signal=SYS_JTCK-SWCLK
PA15.Mode=JTAG_4_pins
PA15.Signal=SYS_JTDI
PB3.Mode=JTAG_4_pins
PB3.Signal=SYS_JTDO-TRACESWO
PC13-TAMPER-RTC.GPIO_Label=Board_led
PC13-TAMPER-RTC.Signal=GPIO_Output
ProjectManager.HeapSize=0x200
ProjectManager.StackSize=0x400
ProjectManager.TargetToolchain=STM32CubeIDE
RCC.APB1Freq_Value=8000000
RCC.APB2Freq_Value=8000000
VP_SYS_VS_tim1.Mode=TIM1
board=custom

// file: Core/Src/main.c
/* USER CODE BEGIN Header */
/**
  ******************************************************************************
  * @file           : main.c
  * @brief          : Main program body
  ******************************************************************************
  * @attention
  *
  * Copyright (c) 2026 STMicroelectronics.
  * All rights reserved.
  *
  * This software is licensed under terms that can be found in the LICENSE file
  * in the root directory of this software component.
  * If no LICENSE file comes with this software, it is provided AS-IS.
  *
  ******************************************************************************
  */
/* USER CODE END Header */
#include "main.h"

/* USER CODE BEGIN Includes */
#include <FreeRTOS.h>
#include <task.h>
/* USER CODE END Includes */

/* USER CODE BEGIN PV */
TaskHandle_t main_task_hndl;
TaskHandle_t measure_task_hndl;
TaskHandle_t counting_task_hndl;
BaseType_t Status;
/* USER CODE END PV */

void SystemClock_Config(void);
static void MX_GPIO_Init(void);
/* USER CODE BEGIN PFP */
void main_task(void* vParameters);
void measure_task(void* vParameters);
void counting_task(void* vParameters);
/* USER CODE END PFP */

/* USER CODE BEGIN 0 */
struct result
{
	int n_of_res;
	int res [20];
};
struct result res;

int temp_avg_result;
/* USER CODE END 0 */

int main(void)
{

  /* MCU Configuration--------------------------------------------------------*/

  /* Reset of all peripherals, Initializes the Flash interface and the Systick. */
  HAL_Init();

  /* Configure the system clock */
  SystemClock_Config();

  /* Initialize all configured peripherals */
  MX_GPIO_Init();
  /* USER CODE BEGIN 2 */
  Status = xTaskCreate(main_task, "main_task", 100, 0, 1, &main_task_hndl);
  Status = xTaskCreate(measure_task, "measure_task", 100, 0, 1, &measure_task_hndl);
  Status = xTaskCreate(counting_task, "counting_task", 100, 0, 1, &counting_task_hndl);
  configASSERT(Status == pdPASS);

  	 vTaskStartScheduler();
  /* USER CODE END 2 */

  /* Infinite loop */
  while (1)
  {

  }
}

void SystemClock_Config(void)
{
  RCC_OscInitTypeDef RCC_OscInitStruct = {0};
  RCC_ClkInitTypeDef RCC_ClkInitStruct = {0};

  /** Initializes the RCC Oscillators according to the specified parameters
  * in the RCC_OscInitTypeDef structure.
  */
  RCC_OscInitStruct.OscillatorType = RCC_OSCILLATORTYPE_HSI;
  RCC_OscInitStruct.HSIState = RCC_HSI_ON;
  RCC_OscInitStruct.HSICalibrationValue = RCC_HSICALIBRATION_DEFAULT;
  RCC_OscInitStruct.PLL.PLLState = RCC_PLL_NONE;
  if (HAL_RCC_OscConfig(&RCC_OscInitStruct) != HAL_OK)
  {
    Error_Handler();
  }

  /** Initializes the CPU, AHB and APB buses clocks
  */
  RCC_ClkInitStruct.ClockType = RCC_CLOCKTYPE_HCLK|RCC_CLOCKTYPE_SYSCLK
                              |RCC_CLOCKTYPE_PCLK1|RCC_CLOCKTYPE_PCLK2;
  RCC_ClkInitStruct.SYSCLKSource = RCC_SYSCLKSOURCE_HSI;
  RCC_ClkInitStruct.AHBCLKDivider = RCC_SYSCLK_DIV1;
  RCC_ClkInitStruct.APB1CLKDivider = RCC_HCLK_DIV1;
  RCC_ClkInitStruct.APB2CLKDivider = RCC_HCLK_DIV1;

  if (HAL_RCC_ClockConfig(&RCC_ClkInitStruct, FLASH_LATENCY_0) != HAL_OK)
  {
    Error_Handler();
  }
}

static void MX_GPIO_Init(void)
{
  GPIO_InitTypeDef GPIO_InitStruct = {0};

  /* GPIO Ports Clock Enable */
  __HAL_RCC_GPIOC_CLK_ENABLE();
  __HAL_RCC_GPIOA_CLK_ENABLE();
  __HAL_RCC_GPIOB_CLK_ENABLE();

  /*Configure GPIO pin Output Level */
  HAL_GPIO_WritePin(Board_led_GPIO_Port, Board_led_Pin, GPIO_PIN_RESET);

  /*Configure GPIO pin : Board_led_Pin */
  GPIO_InitStruct.Pin = Board_led_Pin;
  GPIO_InitStruct.Mode = GPIO_MODE_OUTPUT_PP;
  GPIO_InitStruct.Pull = GPIO_NOPULL;
  GPIO_InitStruct.Speed = GPIO_SPEED_FREQ_LOW;
  HAL_GPIO_Init(Board_led_GPIO_Port, &GPIO_InitStruct);

}

/* USER CODE BEGIN 4 */

void main_task(void* vParameters)
{
	TickType_t xLastWakeTime;
	xLastWakeTime = xTaskGetTickCount();
	while(1)
	{
		xTaskNotify(measure_task_hndl,0,eNoAction);
		xTaskDelayUntil(&xLastWakeTime, pdMS_TO_TICKS(1000));
	}
}

#define MAX_RES_NO	20
#include <stdlib.h>
int tmp_id;

void measure_task(void* vParameters)
{
	res.n_of_res = 0;
	uint8_t table_full = 0;

	while(1)
	{

		xTaskNotifyWait(0,0,0,portMAX_DELAY);
		HAL_GPIO_TogglePin(GPIOC, GPIO_PIN_13);

		if(table_full)
		{
			//prepare the array
			for(int i = 0; i < MAX_RES_NO - 1; i++)
			{
				res.res[i] = res.res[i+1];
			}
		}

		//update the last result
		//TODO: res.res[res.n_of_res] = ADC value
		srand(HAL_GetTick());

		//for testing +/- 15 degrees;
		res.res[res.n_of_res] = (rand()%30)-15;

		if(!table_full)
		{
			tmp_id++;
			res.n_of_res++;
		}

		if(res.n_of_res == MAX_RES_NO)
			{
				table_full = 1;
				res.n_of_res--;
			}

		xTaskNotify(counting_task_hndl,0,eNoAction);

	}
}

void counting_task(void* vParameters)
{
	while(1)
	{
		xTaskNotifyWait(0,0,0,portMAX_DELAY);
//		int temp = 0 ;
//
//		for (int i = 0; i <= res.n_of_res;i++)
//		{
//			temp += res.res;
//		}
//
//		temp_avg_result = temp/res.n_of_res;

	}
}
/* USER CODE END 4 */

void HAL_TIM_PeriodElapsedCallback(TIM_HandleTypeDef *htim)
{
  if (htim->Instance == TIM1)
  {
    HAL_IncTick();
  }
}

void Error_Handler(void)
{
  __disable_irq();
  while (1)
  {
  }
}
